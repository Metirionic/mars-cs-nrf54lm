## common/Kconfig
```kconfig
#
# Copyright (c) 2024 Nordic Semiconductor ASA
#
# SPDX-License-Identifier: MIT
#

menu "Mars Channel Sounding options"

config MARS_CS_TRANSPORT_USB
	bool "Route the COBS stream and console over native USB"
	select USB_DEVICE_STACK_NEXT
	select USBD_CDC_ACM_CLASS
	select HWINFO
	help
	  Carry the initiator's COBS ranging stream and both roles' consoles
	  over the nRF54LM20 native USB (device-next stack, CDC ACM) instead of
	  the onboard debugger's virtual COM ports. Enabled only by the USB
	  board configuration fragments; the VCOM presets never see it, so VCOM
	  builds compile no USB code.

	  The role-specific USB overlays provide the CDC ACM devicetree nodes and
	  chosen nodes (data first, console second for the initiator). The USB
	  transport is brought up after the BLE stack and enabled on VBUS attach,
	  never at boot (NCSDK-38624). Deferred logging is set by the USB board
	  fragment rather than selected here because LOG_MODE_DEFERRED is a
	  choice symbol, which Kconfig does not allow other symbols to select.

config MARS_CS_ROLE_INITIATOR
	bool "USB identity: Channel Sounding initiator"
	depends on MARS_CS_TRANSPORT_USB
	help
	  Select the initiator USB identity: product string "Mars CS Initiator"
	  and product ID 0x0001. Exactly one role symbol must be set in a USB
	  build. The role is a build-time identity choice; it is deliberately
	  independent of the BLE role.

config MARS_CS_ROLE_REFLECTOR
	bool "USB identity: Channel Sounding reflector"
	depends on MARS_CS_TRANSPORT_USB
	help
	  Select the reflector USB identity: product string "Mars CS Reflector"
	  and product ID 0x0002. Exactly one role symbol must be set in a USB
	  build.

config MARS_CS_USB_DEBUG_CONSOLE_VCOM
	bool "Route the USB build's log console to the J-Link VCOM (non-release debug)"
	depends on MARS_CS_TRANSPORT_USB
	depends on MARS_CS_ROLE_INITIATOR
	help
	  Non-release bring-up posture: keep the COBS ranging stream on the
	  native USB data function, but move the log console to the onboard
	  debugger's UART. That makes boot, pre-enumeration, and hard-fault
	  output visible even while USB has not enumerated.

	  A board enables this only from the debug console overlay and
	  fragment, which are deliberately not applied by any CMake preset.
	  CI and the release workflow build and ship every preset, so a debug
	  variant must never become a release preset. In this posture the
	  role's USB console function stays in the descriptor but receives no
	  log output; the initiator's USB COBS backend checks that the chosen
	  console is not a CDC ACM function instead of requiring the console
	  function to be chosen.

config MARS_CS_USB_TX_TIMEOUT_MS
	int "COBS USB transmit stall timeout (ms)"
	default 250
	range 10 60000
	depends on MARS_CS_TRANSPORT_USB
	help
	  Maximum time the serialize consumer waits for the USB transmit path
	  to accept a complete COBS run before the run is dropped and counted.
	  The healthy procedure cadence is ~200 ms at the default interval, so
	  the default bounds the wait to roughly one procedure interval. A host
	  stall therefore degrades to counted drops instead of blocking the
	  consumer forever.

config MARS_CS_INLINE_PCT
	bool "Enable inline Phase Correction Term Transfer (IPT) mode"
	depends on BT_CHANNEL_SOUNDING
	select BT_CTLR_EXTENDED_FEAT_SET
	help
	  Enable inline PCT (Phase Correction Term) transfer mode, mirroring
	  the Nordic ipt_* samples. The initiator uses only the local
	  le_cs_subevent_data_available results for distance estimation,
	  the reflector's PCT contribution is embedded in the received
	  tones, so the Ranging Service (RAS) GATT path is not used.

	  When enabled, this option is mutually exclusive with the RAS
	  Requestor/Responder roles (CONFIG_BT_RAS_RREQ / CONFIG_BT_RAS_RRSP),
	  which the application conf fragments set to n.

	  Note: inline PCT only applies to PBR (Main Mode 2). The CS
	  configuration is forced to BT_CONN_LE_CS_MAIN_MODE_2_NO_SUB_MODE
	  in this mode.

config MARS_CS_LIVENESS_WATCHDOG
	bool "Enable CS liveness watchdog (forced disconnect + reboot on stall)"
	default y
	depends on BT_CHANNEL_SOUNDING
	help
	  Recover from permanent CS abort-storms (#116) where every procedure's
	  subevents abort at the LL while BLE + RAS stay healthy (empty Ranging
	  Data frames keep flowing, so frame flow is not a liveness signal).
	  The watchdog is petted once per completed procedure WITH step data
	  (RAS: ranging_data_cb healthy path; IPT: process_subevent_cb;
	  reflector: COMPLETE subevents with steps). On timeout it logs a
	  banner and forces a disconnect via the registered recovery callback,
	  which reboots both boards through the existing reboot-on-disconnect
	  path and re-runs the full handshake.

config MARS_CS_LIVENESS_WATCHDOG_TIMEOUT_MS
	int "CS liveness watchdog timeout in ms"
	default 5000
	depends on MARS_CS_LIVENESS_WATCHDOG
	help
	  Maximum time without a completed procedure with step data before the
	  watchdog forces recovery. The healthy procedure cadence is ~200 ms
	  (25x headroom at the default); the watchdog is inert until the first
	  pet, so handshake gaps never false-trigger it.

config MARS_CS_LIVENESS_WATCHDOG_TEST_NO_PET
	bool "Never pet the CS liveness watchdog (test hook)"
	default n
	depends on MARS_CS_LIVENESS_WATCHDOG
	help
	  Deterministic recovery-loop test for desk bring-up: the watchdog
	  never pets and fires ~timeout after the first healthy procedure.
	  Do not enable in production builds.

endmenu
```
