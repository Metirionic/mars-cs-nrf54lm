## CMakeLists.txt
```
# SPDX-License-Identifier: MIT
cmake_minimum_required(VERSION 3.20.0)

list(APPEND BOARD_ROOT ${CMAKE_CURRENT_LIST_DIR}/..)

find_package(Zephyr REQUIRED HINTS $ENV{ZEPHYR_BASE})
project(channel_sounding_ras_reflector)

target_sources(
  app PRIVATE src/main.c ${CMAKE_CURRENT_LIST_DIR}/../common/antenna.c
              ${CMAKE_CURRENT_LIST_DIR}/../common/cs_watchdog.c)

# The shared USB bring-up module is compiled only for native USB builds, so VCOM
# builds compile no USB code at all.
if(CONFIG_MARS_CS_TRANSPORT_USB)
  target_sources(app PRIVATE ${CMAKE_CURRENT_LIST_DIR}/../common/mars_usb.c)
endif()

target_include_directories(app PRIVATE src ${CMAKE_CURRENT_LIST_DIR}/../common)
```

## sample.yaml
```
sample:
  description: Bluetooth Low Energy Channel Sounding Reflector with Ranging Service Responder
  name: Bluetooth LE Channel Sounding Reflector with RRSP
tests:
  sample.bluetooth.channel_sounding_ras_reflector:
    sysbuild: true
    build_only: true
    integration_platforms:
      - nrf54lm20dk/nrf54lm20a/cpuapp
      - nrf54lm20dk/nrf54lm20b/cpuapp
    platform_allow:
      - nrf54lm20dk/nrf54lm20a/cpuapp
      - nrf54lm20dk/nrf54lm20b/cpuapp
    tags: bluetooth ci_build sysbuild
  sample.bluetooth.channel_sounding_ipt_reflector:
    sysbuild: true
    build_only: true
    integration_platforms:
      - nrf54lm20dk/nrf54lm20a/cpuapp
      - nrf54lm20dk/nrf54lm20b/cpuapp
    platform_allow:
      - nrf54lm20dk/nrf54lm20a/cpuapp
      - nrf54lm20dk/nrf54lm20b/cpuapp
    extra_configs:
      - CONFIG_MARS_CS_INLINE_PCT=y
      - CONFIG_BT_RAS_RRSP=n
    tags: bluetooth ci_build sysbuild
```

## prj.conf
```kconfig
#
# Copyright (c) 2024 Nordic Semiconductor ASA
#
# SPDX-License-Identifier: MIT
#

CONFIG_NCS_SAMPLES_DEFAULTS=y
CONFIG_DK_LIBRARY=y

CONFIG_BT=y
CONFIG_BT_PERIPHERAL=y
CONFIG_BT_SMP=y
CONFIG_BT_DEVICE_NAME="Nordic CS Reflector"
CONFIG_BT_MAX_CONN=1
CONFIG_BT_GAP_AUTO_UPDATE_CONN_PARAMS=n
CONFIG_BT_BONDABLE=n

# The Ranging Profile recommends a MTU of at least 247 octets.
CONFIG_BT_L2CAP_TX_MTU=498
CONFIG_BT_BUF_ACL_TX_SIZE=502
CONFIG_BT_BUF_ACL_RX_SIZE=502
CONFIG_BT_CTLR_DATA_LENGTH_MAX=251
CONFIG_BT_CTLR_PHY_2M=y

# This reduces RAM usage. Additional RAM is needed to support optional
# features such as mode 3 or more than one local antenna. Change or
# remove these if using those features.
CONFIG_BT_RAS_MODE_3_SUPPORTED=n
CONFIG_BT_CTLR_SDC_CS_STEP_MODE3=n

# Reassembly buffer for one CS subevent split across HCI events. 4,800 is the
# maximum under the NCS RAS Kconfig override (RAS builds only) and is above
# the NCS default for four antenna paths without Mode 3 (3,840). Mode 3 is
# disabled above, and the four-path policy adds no local antenna path (the DK
# has one antenna), so the buffer stays.
CONFIG_BT_CHANNEL_SOUNDING_REASSEMBLY_BUFFER_SIZE=4800

# This allows CS and ACL to use different PHYs
CONFIG_BT_TRANSMIT_POWER_CONTROL=y

CONFIG_BT_CHANNEL_SOUNDING=y
CONFIG_BT_RAS=y
CONFIG_BT_RAS_RRSP=y
```

## src/main.c
```c
/*
 * Copyright (c) 2024 Nordic Semiconductor ASA
 *
 * SPDX-License-Identifier: MIT
 */

/** @file
 *  @brief Channel Sounding Reflector with Ranging Responder sample
 */

#if !defined(CONFIG_MARS_CS_INLINE_PCT)
#include <bluetooth/services/ras.h>
#endif  // !defined(CONFIG_MARS_CS_INLINE_PCT)
#include <dk_buttons_and_leds.h>
#include <zephyr/bluetooth/bluetooth.h>
#include <zephyr/bluetooth/conn.h>
#include <zephyr/bluetooth/cs.h>
#include <zephyr/bluetooth/uuid.h>
#include <zephyr/kernel.h>
#include <zephyr/logging/log.h>
#include <zephyr/logging/log_ctrl.h>
#include <zephyr/settings/settings.h>
#include <zephyr/sys/byteorder.h>
#include <zephyr/sys/reboot.h>

#include "antenna.h"
#include "cs_watchdog.h"
#include "mars_usb.h"

LOG_MODULE_REGISTER(app_main, LOG_LEVEL_INF);

/** @brief LED used to indicate an active BLE connection. */
#define CON_STATUS_LED DK_LED1

/** @brief Semaphore signaled when a BLE connection is established. */
static K_SEM_DEFINE(sem_connected, 0, 1);
/** @brief Semaphore signaled when CS config creation completes. */
static K_SEM_DEFINE(sem_config, 0, 1);

/** @brief Current BLE connection reference. */
static struct bt_conn * gp_connection;

/** @brief BLE advertising data — flags, device name, and (in RAS mode) Ranging Service UUID. */
#if IS_ENABLED(CONFIG_MARS_CS_INLINE_PCT)
static const struct bt_data ad[] = {
    BT_DATA_BYTES(BT_DATA_FLAGS, (BT_LE_AD_GENERAL | BT_LE_AD_NO_BREDR)),
    BT_DATA(BT_DATA_NAME_COMPLETE, CONFIG_BT_DEVICE_NAME, sizeof(CONFIG_BT_DEVICE_NAME) - 1),
};
#else   // IS_ENABLED(CONFIG_MARS_CS_INLINE_PCT)
static const struct bt_data ad[] = {
    BT_DATA_BYTES(BT_DATA_FLAGS, (BT_LE_AD_GENERAL | BT_LE_AD_NO_BREDR)),
    BT_DATA_BYTES(BT_DATA_UUID16_ALL, BT_UUID_16_ENCODE(BT_UUID_RANGING_SERVICE_VAL)),
    BT_DATA(BT_DATA_NAME_COMPLETE, CONFIG_BT_DEVICE_NAME, sizeof(CONFIG_BT_DEVICE_NAME) - 1),
};
#endif  // IS_ENABLED(CONFIG_MARS_CS_INLINE_PCT)

/** @brief Callback for BLE connection established — stores connection ref and lights LED. */
static void connected_cb(struct bt_conn * conn, uint8_t err)
{
    char addr[BT_ADDR_LE_STR_LEN];

    (void)bt_addr_le_to_str(bt_conn_get_dst(conn), addr, sizeof(addr));
    LOG_INF("Connected to %s (err 0x%02X)", addr, err);

    if (err)
    {
        bt_conn_unref(conn);
        gp_connection = NULL;
    }
    else
    {
        gp_connection = bt_conn_ref(conn);

        k_sem_give(&sem_connected);

        dk_set_led_on(CON_STATUS_LED);
    }
}

/** @brief Callback for BLE disconnection — reboots the device. */
static void disconnected_cb(struct bt_conn * conn, uint8_t reason)
{
    LOG_INF("Disconnected (reason 0x%02X)", reason);

    bt_conn_unref(conn);
    gp_connection = NULL;

    dk_set_led_off(CON_STATUS_LED);

    /* Deferred logging: sys_reboot resets the SoC without draining the log
     * queue, so flush it explicitly. On a VCOM console this is the only trace
     * of the disconnect (and of any pending watchdog recovery) before the
     * board reboots; on the USB console it is best-effort. */
    LOG_PANIC();
    sys_reboot(SYS_REBOOT_COLD);
}

/** @brief Callback for CS remote capabilities exchange completion. */
static void remote_capabilities_cb(struct bt_conn * conn, uint8_t status, struct bt_conn_le_cs_capabilities * params)
{
    ARG_UNUSED(conn);

    if (status == BT_HCI_ERR_SUCCESS)
    {
        antenna_set_peer_count(params->num_antennas_supported);
        LOG_INF("CS capability exchange completed. (peer antennas: %u)", params->num_antennas_supported);
    }
    else
    {
        LOG_WRN("CS capability exchange failed. (HCI status 0x%02x)", status);
    }
}

/** @brief Callback for CS config creation — logs config details and signals semaphore. */
static void config_create_cb(struct bt_conn * conn, uint8_t status, struct bt_conn_le_cs_config * config)
{
    ARG_UNUSED(conn);

    if (status == BT_HCI_ERR_SUCCESS)
    {
        const char * mode_str[5]       = {"Unused", "1 (RTT)", "2 (PBR)", "3 (RTT + PBR)", "Invalid"};
        const char * role_str[3]       = {"Initiator", "Reflector", "Invalid"};
        const char * rtt_type_str[8]   = {"AA only",
                                          "32-bit sounding",
                                          "96-bit sounding",
                                          "32-bit random",
                                          "64-bit random",
                                          "96-bit random",
                                          "128-bit random",
                                          "Invalid"};
        const char * phy_str[4]        = {"Invalid", "LE 1M PHY", "LE 2M PHY", "LE 2M 2BT PHY"};
        const char * chsel_type_str[3] = {"Algorithm #3b", "Algorithm #3c", "Invalid"};
        const char * ch3c_shape_str[3] = {"Hat shape", "X shape", "Invalid"};

        uint8_t mode_idx       = config->mode > 0 && config->mode < 4 ? config->mode : 4;
        uint8_t role_idx       = MIN(config->role, 2);
        uint8_t rtt_type_idx   = MIN(config->rtt_type, 7);
        uint8_t phy_idx        = config->cs_sync_phy > 0 && config->cs_sync_phy < 4 ? config->cs_sync_phy : 0;
        uint8_t chsel_type_idx = MIN(config->channel_selection_type, 2);
        uint8_t ch3c_shape_idx = MIN(config->ch3c_shape, 2);

        LOG_INF(
            "CS config creation complete.\n"
            " - id: %u\n"
            " - mode: %s\n"
            " - min_main_mode_steps: %u\n"
            " - max_main_mode_steps: %u\n"
            " - main_mode_repetition: %u\n"
            " - mode_0_steps: %u\n"
            " - role: %s\n"
            " - rtt_type: %s\n"
            " - cs_sync_phy: %s\n"
            " - channel_map_repetition: %u\n"
            " - channel_selection_type: %s\n"
            " - ch3c_shape: %s\n"
            " - ch3c_jump: %u\n"
            " - t_ip1_time_us: %u\n"
            " - t_ip2_time_us: %u\n"
            " - t_fcs_time_us: %u\n"
            " - t_pm_time_us: %u\n"
            " - channel_map: 0x%08X%08X%04X\n",
            config->id,
            mode_str[mode_idx],
            config->min_main_mode_steps,
            config->max_main_mode_steps,
            config->main_mode_repetition,
            config->mode_0_steps,
            role_str[role_idx],
            rtt_type_str[rtt_type_idx],
            phy_str[phy_idx],
            config->channel_map_repetition,
            chsel_type_str[chsel_type_idx],
            ch3c_shape_str[ch3c_shape_idx],
            config->ch3c_jump,
            config->t_ip1_time_us,
            config->t_ip2_time_us,
            config->t_fcs_time_us,
            config->t_pm_time_us,
            sys_get_le32(&config->channel_map[6]),
            sys_get_le32(&config->channel_map[2]),
            sys_get_le16(&config->channel_map[0]));

        k_sem_give(&sem_config);
    }
    else
    {
        LOG_WRN("CS config creation failed. (HCI status 0x%02x)", status);
    }
}

/** @brief Callback for CS security enable completion. */
static void security_enable_cb(struct bt_conn * conn, uint8_t status)
{
    ARG_UNUSED(conn);

    if (status == BT_HCI_ERR_SUCCESS)
    {
        LOG_INF("CS security enabled.");
    }
    else
    {
        LOG_WRN("CS security enable failed. (HCI status 0x%02x)", status);
    }
}

/** @brief Callback for CS procedure enable completion — logs procedure parameters. */
static void procedure_enable_cb(struct bt_conn *                                 conn,
                                uint8_t                                          status,
                                struct bt_conn_le_cs_procedure_enable_complete * params)
{
    ARG_UNUSED(conn);

    if (status == BT_HCI_ERR_SUCCESS)
    {
        if (params->state == 1)
        {
            LOG_INF(
                "CS procedures enabled:\n"
                " - config ID: %u\n"
                " - antenna configuration index: %u\n"
                " - TX power: %d dbm\n"
                " - subevent length: %u us\n"
                " - subevents per event: %u\n"
                " - subevent interval: %u\n"
                " - event interval: %u\n"
                " - procedure interval: %u\n"
                " - procedure count: %u\n"
                " - maximum procedure length: %u",
                params->config_id,
                params->tone_antenna_config_selection,
                params->selected_tx_power,
                params->subevent_len,
                params->subevents_per_event,
                params->subevent_interval,
                params->event_interval,
                params->procedure_interval,
                params->procedure_count,
                params->max_procedure_len);
        }
        else
        {
            LOG_INF("CS procedures disabled.");
        }
    }
    else
    {
        LOG_WRN("CS procedures enable failed. (HCI status 0x%02x)", status);
    }
}

BT_CONN_CB_DEFINE(conn_cb) = {
    .connected                               = connected_cb,
    .disconnected                            = disconnected_cb,
    .le_cs_read_remote_capabilities_complete = remote_capabilities_cb,
    .le_cs_config_complete                   = config_create_cb,
    .le_cs_security_enable_complete          = security_enable_cb,
    .le_cs_procedure_enable_complete         = procedure_enable_cb,
};

/** @brief Fallback reboot if the watchdog's forced disconnect never completes. */
static void reboot_fallback_handler(struct k_timer * timer)
{
    ARG_UNUSED(timer);

    sys_reboot(SYS_REBOOT_COLD);
}

static K_TIMER_DEFINE(reboot_fallback, reboot_fallback_handler, NULL);

/**
 * @brief CS liveness watchdog pet source (#116).
 *
 * Pets only on subevents that COMPLETED with step data — the mirror of the
 * initiator's step accumulation (aborted subevents are discarded there). The
 * RRSP's RD-ready notify is NOT a liveness signal: it fires on procedures
 * whose subevents all aborted, which is exactly the storm signature.
 */
static void cs_watchdog_subevent_cb(struct bt_conn * conn, struct bt_conn_le_cs_subevent_result * result)
{
    ARG_UNUSED(conn);

    if (result->header.subevent_done_status == BT_CONN_LE_CS_SUBEVENT_ABORTED)
    {
        /* Desk observability for the #116 root-cause follow-up: the LL abort
         * reasons (NO_CS_SYNC vs SCHED_CONFLICT) are invisible on the rig. */
        LOG_WRN(
            "CS subevent aborted: proc=%u sub_abort_reason=%u proc_abort_reason=%u "
            "nsteps=%u abort_step=%u",
            result->header.procedure_counter,
            result->header.subevent_abort_reason,
            result->header.procedure_abort_reason,
            result->header.num_steps_reported,
            result->header.abort_step);
        return;
    }

    if (result->header.subevent_done_status == BT_CONN_LE_CS_SUBEVENT_COMPLETE && result->header.num_steps_reported > 0)
    {
        cs_watchdog_pet();
    }
}

BT_CONN_CB_DEFINE(cs_watchdog_conn_cb) = {
    .le_cs_subevent_data_available = cs_watchdog_subevent_cb,
};

/**
 * @brief Watchdog recovery: force disconnect (reboots both boards) or reboot.
 *
 * Invoked by the watchdog's system-workqueue work item, never from the timer
 * expiry ISR, so the HCI sync-command wait inside bt_conn_disconnect is legal.
 * A successful disconnect lets the existing disconnected_cb -> sys_reboot
 * path recover the pair; the 2 s fallback timer covers a disconnect that the
 * controller accepts but never completes.
 *
 * CONFIG_BT_TX_PROCESSOR_THREAD=y keeps the HCI TX path off this workqueue, so
 * the wait cannot deadlock it; a refused command returns and takes the reboot
 * branch, and a command that never completes ends in the sync wait's timeout
 * assertion.
 *
 * The disconnect reason is CS_WATCHDOG_DISCONNECT_REASON, not the
 * semantically correct 0x16: the controller rejects 0x16 with HCI status 0x12
 * (see common/cs_watchdog.h).
 */
static void cs_watchdog_recovery_cb(void)
{
    if (gp_connection != NULL && bt_conn_disconnect(gp_connection, CS_WATCHDOG_DISCONNECT_REASON) == 0)
    {
        k_timer_start(&reboot_fallback, K_MSEC(2000), K_NO_WAIT);
        return;
    }

    sys_reboot(SYS_REBOOT_COLD);
}

int main(void)
{
    int err;

    LOG_INF("Starting Mars Channel Sounding Reflector");

    dk_leds_init();

    err = bt_enable(NULL);
    if (err)
    {
        LOG_ERR("Bluetooth init failed (err %d)", err);
        return 0;
    }

#if IS_ENABLED(CONFIG_MARS_CS_TRANSPORT_USB)
    /* Native USB is initialized after the BLE stack: MPSL and the shared
     * HFCLK24M are already up (DRGN-29129 / DRGN-29277). Initialization does
     * not connect the device; the UDC waits for VBUS, so boot never blocks on
     * a missing host and CDC ACM serial init never runs at boot (NCSDK-38624). */
    err = mars_usb_init();
    if (err)
    {
        LOG_ERR("USB init failed (err %d)", err);
        return 0;
    }
#endif

    /* CS liveness watchdog (#116): inert until the first completed subevent
     * with step data pets it, so the handshake never false-triggers it. */
    cs_watchdog_init(cs_watchdog_recovery_cb);

    if (IS_ENABLED(CONFIG_BT_SETTINGS))
    {
        settings_load();
    }

    err = bt_le_adv_start(BT_LE_ADV_CONN_FAST_2, ad, ARRAY_SIZE(ad), NULL, 0);
    if (err)
    {
        LOG_ERR("Advertising failed to start (err %d)", err);
        return 0;
    }

    while (true)
    {
        k_sem_take(&sem_connected, K_FOREVER);

        const struct bt_le_cs_set_default_settings_param default_settings = {
            .enable_initiator_role     = false,
            .enable_reflector_role     = true,
            .cs_sync_antenna_selection = BT_LE_CS_ANTENNA_SELECTION_OPT_REPETITIVE,
            .max_tx_power              = BT_HCI_OP_LE_CS_MAX_MAX_TX_POWER,
        };

        err = bt_le_cs_set_default_settings(gp_connection, &default_settings);
        if (err)
        {
            LOG_ERR("Failed to configure default CS settings (err %d)", err);
            return 0;
        }

#if IS_ENABLED(CONFIG_MARS_CS_INLINE_PCT)
        /*
         * IPT mode: the connected central device performs the rest of the CS
         * setup (config creation, security enable, procedure parameters and
         * enable). The reflector does not set procedure parameters or expose
         * the Ranging Service. The reflector reboots on disconnect, so the
         * outer loop simply re-waits for the next connection (moot in normal
         * operation but kept for symmetry with the RAS path).
         */
        continue;
#else   // IS_ENABLED(CONFIG_MARS_CS_INLINE_PCT)
        k_sem_take(&sem_config, K_FOREVER);

        const uint8_t ANTENNA_CONFIG         = antenna_get_config_for_role(BT_CONN_LE_CS_ROLE_REFLECTOR);
        const uint8_t PREFERRED_PEER_ANTENNA = antenna_get_peer_mask();

        LOG_INF("Local antennas: %d, paths: %d, using config: %d, preferred peer antenna: %d",
                CONFIG_BT_CTLR_SDC_CS_NUM_ANTENNAS,
                CONFIG_BT_CTLR_SDC_CS_MAX_ANTENNA_PATHS,
                ANTENNA_CONFIG,
                PREFERRED_PEER_ANTENNA);

        /* The subevent length suggestions deliberately span the full usable
         * spec range (1250–75000 us; 1250 is the HCI-specified floor, see
         * zephyr/include/zephyr/bluetooth/cs.h) so that any subevent length
         * the initiator computes from its negotiated config intersects this
         * window. */
        const struct bt_le_cs_set_procedure_parameters_param procedure_params = {
            .config_id                     = 0,
            .max_procedure_len             = 1000,
            .min_procedure_interval        = 1,
            .max_procedure_interval        = 100,
            .max_procedure_count           = 0,
            .min_subevent_len              = 1250,
            .max_subevent_len              = 75000,
            .tone_antenna_config_selection = ANTENNA_CONFIG,
            .phy                           = BT_LE_CS_PROCEDURE_PHY_2M,
            .tx_power_delta                = 0x80,
            .preferred_peer_antenna        = PREFERRED_PEER_ANTENNA,
            .snr_control_initiator         = BT_LE_CS_SNR_CONTROL_NOT_USED,
            .snr_control_reflector         = BT_LE_CS_SNR_CONTROL_NOT_USED,
        };

        err = bt_le_cs_set_procedure_parameters(gp_connection, &procedure_params);
        if (err)
        {
            LOG_ERR("Failed to set procedure parameters (err %d)", err);
            return 0;
        }
#endif  // IS_ENABLED(CONFIG_MARS_CS_INLINE_PCT)
    }

    return 0;
}
```
