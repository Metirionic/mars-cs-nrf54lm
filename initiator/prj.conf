## CMakeLists.txt
```
# SPDX-License-Identifier: MIT
cmake_minimum_required(VERSION 3.20.0)

list(APPEND BOARD_ROOT ${CMAKE_CURRENT_LIST_DIR}/..)

include(FetchContent)
FetchContent_Declare(
  mars-bluetooth-hci
  GIT_REPOSITORY https://github.com/Metirionic/mars-bluetooth-hci.git
  GIT_TAG mars-bluetooth-hci@0.13.2)
FetchContent_MakeAvailable(mars-bluetooth-hci)

set(MARS_BT_HCI_RUST_DIR ${mars-bluetooth-hci_SOURCE_DIR}/mars-bluetooth-hci)
set(RUST_TARGET "thumbv8m.main-none-eabihf")

list(APPEND CMAKE_PREFIX_PATH ${MARS_BT_HCI_RUST_DIR})
find_package(mars-bluetooth-hci-rust)
find_package(Zephyr REQUIRED HINTS $ENV{ZEPHYR_BASE})

project(initiator)

add_subdirectory(${CMAKE_CURRENT_LIST_DIR}/../common cs_common)

target_sources(app PRIVATE src/main.c src/serialize.c
                           ${CMAKE_CURRENT_LIST_DIR}/../common/rust_callbacks.c)

# Exactly one COBS TX backend is built: the USB backend is only compiled when
# the USB board fragment selects the native USB transport, so VCOM builds carry
# no USB code (and USB builds carry no VCOM backend).
if(CONFIG_MARS_CS_TRANSPORT_USB)
  target_sources(app PRIVATE src/cobs_tx_usb.c)
else()
  target_sources(app PRIVATE src/cobs_tx_vcom.c)
endif()

target_include_directories(app PRIVATE src)
target_link_libraries(app PRIVATE cs_common)
target_include_directories(cs_common
                           PUBLIC ${MARS_BT_HCI_RUST_INCLUDE_DIRECTORIES})

add_dependencies(app build_mars_bt_hci_rust)
target_link_libraries(app PRIVATE ${MARS_BT_HCI_RUST_LINK_LIBRARIES})
```

## Kconfig
```
#
# Copyright (c) 2024 Nordic Semiconductor ASA
#
# SPDX-License-Identifier: MIT
#

source "$(APPLICATION_SOURCE_DIR)/../common/Kconfig"

menu "Mars Channel Sounding initiator options"

config MARS_CS_PROCEDURE_INTERVAL
	int "Channel Sounding procedure interval (connection events)"
	default 10
	range 1 65535
	depends on BT_CHANNEL_SOUNDING
	help
	  Minimum and maximum interval between consecutive Channel Sounding
	  procedures, in connection events, for the initiator. Both the
	  minimum and the maximum procedure interval are set to this value,
	  so the controller schedules one procedure every interval
	  connection events.

	  The default of 10 matches the Nordic ras_initiator sample and the
	  firmware's released cadence, so default builds are unchanged.

	  Set this to 1 to build the high-cadence variant used by the bench's
	  transport-headroom run. That requests a procedure at every
	  connection event; the controller applies its own minimum (the
	  Nordic SDC on the nRF54LM20-DK reports 2), which still tightens the
	  cadence about fivefold against the default. The tightened cadence
	  makes the COBS transport, not the procedure scheduler, the limiting
	  factor. This is a build-time bench lever; there is no runtime
	  control.

config MARS_CS_DISCONNECT_FRAME_TIMEOUT_MS
	int "Bound on the initiator's disconnect COBS frame (ms)"
	default 200
	range 20 2000
	depends on BT_CHANNEL_SOUNDING
	help
	  Maximum time the initiator spends emitting the terminal COBS log
	  frame that carries the BLE disconnect reason, measured from the
	  disconnect callback to the drain completing. The frame is best
	  effort: if the transmit path cannot be acquired, serialized,
	  submitted, and drained within this bound — a ranging run is still
	  in flight, the host has stalled, or the transport is wedged — the
	  reboot proceeds without it.

	  The bound covers the acquisition wait as well as the drain, so the
	  reboot is never held past it. The default of 200 ms is below the
	  healthy procedure cadence (~330 ms at the default interval) and well
	  below the CS liveness watchdog's 3 s backstop.

endmenu

source "Kconfig.zephyr"
```

## sample.yaml
```
sample:
  description: Bluetooth Low Energy Channel Sounding Initiator with Ranging Service Requester
  name: Bluetooth LE Channel Sounding Initiator with RREQ
tests:
  sample.bluetooth.channel_sounding_ras_initiator:
    sysbuild: true
    build_only: true
    integration_platforms:
      - nrf54lm20dk/nrf54lm20a/cpuapp
      - nrf54lm20dk/nrf54lm20b/cpuapp
    platform_allow:
      - nrf54lm20dk/nrf54lm20a/cpuapp
      - nrf54lm20dk/nrf54lm20b/cpuapp
    tags: bluetooth ci_build sysbuild
  sample.bluetooth.channel_sounding_ipt_initiator:
    sysbuild: true
    build_only: true
    integration_platforms:
      - nrf54lm20dk/nrf54lm20a/cpuapp
      - nrf54lm20dk/nrf54lm20b/cpuapp
    platform_allow:
      - nrf54lm20dk/nrf54lm20a/cpuapp
      - nrf54lm20dk/nrf54lm20b/cpuapp
    extra_configs:
      - CONFIG_MARS_CS_INLINE_PCT=y
      - CONFIG_BT_RAS_RREQ=n
    tags: bluetooth ci_build sysbuild
```

## prj.conf
```kconfig
#
# Copyright (c) 2024 Nordic Semiconductor ASA
#
# SPDX-License-Identifier: MIT
#

CONFIG_NCS_SAMPLES_DEFAULTS=y
CONFIG_DK_LIBRARY=y

CONFIG_BT=y
CONFIG_BT_SMP=y
CONFIG_BT_MAX_CONN=1
CONFIG_BT_BONDABLE=n

CONFIG_BT_GATT_CLIENT=y
CONFIG_BT_GATT_DYNAMIC_DB=y
CONFIG_BT_CENTRAL=y
CONFIG_BT_SCAN=y
CONFIG_BT_SCAN_FILTER_ENABLE=y
CONFIG_BT_SCAN_UUID_CNT=1

CONFIG_BT_CHANNEL_SOUNDING=y
CONFIG_BT_RAS=y
CONFIG_BT_RAS_RREQ=y

CONFIG_UART_ASYNC_API=y
# A UART driver device is required for the cobs-uart chosen node the VCOM COBS
# TX backend acquires in src/cobs_tx_vcom.c
# (DEVICE_DT_GET(DT_CHOSEN(cobs_uart))). Enable the serial driver at the app
# level so every board preset gets it, including board definitions whose
# defconfig does not enable it.
CONFIG_SERIAL=y
CONFIG_NEWLIB_LIBC=y

# The Ranging Profile recommends a MTU of at least 247 octets.
CONFIG_BT_L2CAP_TX_MTU=498
CONFIG_BT_BUF_ACL_TX_SIZE=502
CONFIG_BT_BUF_ACL_RX_SIZE=502
CONFIG_BT_ATT_PREPARE_COUNT=3
CONFIG_BT_CTLR_DATA_LENGTH_MAX=251

# This reduces RAM usage. Additional RAM is needed to support optional
# features such as mode 3 or more than one local antenna. Change or
# remove these if using those features.
CONFIG_BT_RAS_MODE_3_SUPPORTED=n
CONFIG_BT_CTLR_SDC_CS_STEP_MODE3=n

# Reassembly buffer for one CS subevent split across HCI events. 4,800 is the
# maximum under the NCS RAS Kconfig override (RAS builds only) and is above
# the NCS default for four antenna paths without Mode 3 (3,840). Mode 3 is
# disabled above, and the four-path policy adds no local antenna path (the DK
# has one antenna), so the buffer stays.
CONFIG_BT_CHANNEL_SOUNDING_REASSEMBLY_BUFFER_SIZE=4800

# This allows CS and ACL to use different PHYs
CONFIG_BT_TRANSMIT_POWER_CONTROL=y

# This improves the performance of floating-point operations
CONFIG_FPU=y
CONFIG_FPU_SHARING=y

CONFIG_HEAP_MEM_POOL_SIZE=32768
CONFIG_MAIN_STACK_SIZE=10000
CONFIG_CBPRINTF_FP_SUPPORT=y

CONFIG_BT_CS_DE=y
```

## src/main.c
```c
/*
 * Copyright (c) 2024 Nordic Semiconductor ASA
 *
 * SPDX-License-Identifier: MIT
 */

/** @file
 *  @brief Channel Sounding initiator with ranging requester sample
 */

#include <stdarg.h>
#include <stdio.h>
#include <zephyr/bluetooth/cs.h>
#include <zephyr/drivers/gpio.h>
#include <zephyr/kernel.h>
#include <zephyr/logging/log.h>
#include <zephyr/sys/reboot.h>

#if !defined(CONFIG_MARS_CS_INLINE_PCT)
#include <bluetooth/services/ras.h>
#endif

#include "addr_utils.h"
#include "antenna.h"
#include "ble_callbacks.h"
#include "cs_initiator.h"
#include "cs_watchdog.h"
#include "mars_usb.h"
#include "serialize.h"
#include "subevent.h"

LOG_MODULE_REGISTER(app_main, LOG_LEVEL_INF);

/** @brief Saved CS config from config creation callback (used for role in serialization). */
static struct bt_conn_le_cs_config cs_config;

/**
 * @brief Process a populated event pair by serializing it over the COBS UART.
 *
 * Called on the main loop thread from cs_initiator_consume_pending_event(); the RX thread only populates the shared
 * event pair — RAS from ranging_data_cb, IPT from the shared procedure-completion skeleton. The blocking serialize +
 * UART TX path must stay off the RX thread, where it would delay the SDC's step-data delivery until the controller
 * aborts the surplus subevents (#173 — numbers in docs/architecture.md).
 */
static void process_subevent_cb(SubeventResultEvent_t * p_local_event, SubeventResultEvent_t * p_peer_event)
{
#if IS_ENABLED(CONFIG_MARS_CS_INLINE_PCT)
    /* CS liveness watchdog (#116): the IPT skeleton hands over completed procedures with step data, and this thread
     * consumes them at the wire rate — so the pet paces at the consume rate, not the completion rate, and holds the
     * link while the wire keeps up (see #173). RAS keeps its v0.1.0 pet on the completion signal itself, in
     * ranging_data_cb, so a transport stall cannot turn into a watchdog recovery it did not have before. */
    cs_watchdog_pet();
#endif

    serialize_run(p_local_event, p_peer_event);
}

#if !IS_ENABLED(CONFIG_MARS_CS_INLINE_PCT)
/** @brief Emit a diagnostic message queued by the RX thread (consumer thread). */
static void process_log_cb(const char * p_message)
{
    (void)serialize_send_log_message(p_message);
}

/** @brief Queue a formatted COBS diagnostic frame for the consumer thread. */
static void queue_diagnostic(const char * p_format, ...)
{
    char    msg[CS_INITIATOR_LOG_MESSAGE_MAX_LEN];
    va_list args;

    va_start(args, p_format);
    vsnprintf(msg, sizeof(msg), p_format, args);
    va_end(args);

    cs_initiator_queue_log_message(msg);
}

/**
 * @brief Callback for ranging data received from peer (realtime or on-demand).
 *
 * Checks counter match, validates step data, populates the shared
 * SubeventResultEvents via subevent_populate, and hands them to the consumer
 * thread, which serializes and transmits — no serialize or transmit work runs
 * in this RX callback (#15). Fault-path diagnostics are queued for the same
 * consumer through cs_initiator_queue_log_message().
 */
static void ranging_data_cb(struct bt_conn * p_conn, uint16_t ranging_counter, int err)
{
    ARG_UNUSED(p_conn);

    if (err)
    {
        LOG_ERR("Error when receiving ranging data with ranging counter %d (err %d)", ranging_counter, err);
        /* Fault-path diagnostic: make the stall trigger visible on the COBS
         * UART — the host's only window into the initiator. */
        queue_diagnostic("RD error: counter %u, err %d", ranging_counter, err);

        /* Mirror the mismatch/aborted recovery below: the sem was taken at
         * the new-procedure gate in cs_initiator.c, and without this give
         * every subsequent procedure drops at the gate — the data path (and
         * COBS stream) stalls permanently (see #109). */
        net_buf_simple_reset(cs_initiator_get_local_steps());

        if (!(cs_initiator_get_ras_feature_bits() & RAS_FEAT_REALTIME_RD))
        {
            net_buf_simple_reset(cs_initiator_get_peer_steps());
        }

        cs_initiator_give_sem_local_steps();
        return;
    }

    int32_t local_ranging_counter = cs_initiator_get_local_ranging_counter();

    if (ranging_counter != local_ranging_counter)
    {
        LOG_INF(
            "Ranging data dropped as peer ranging counter doesn't match local ranging "
            "data counter. (peer: %u, local: %u)",
            ranging_counter,
            local_ranging_counter);

        queue_diagnostic("RD dropped: peer %u, local %u", ranging_counter, local_ranging_counter);

        net_buf_simple_reset(cs_initiator_get_local_steps());

        if (!(cs_initiator_get_ras_feature_bits() & RAS_FEAT_REALTIME_RD))
        {
            net_buf_simple_reset(cs_initiator_get_peer_steps());
        }

        cs_initiator_give_sem_local_steps();
        return;
    }

    LOG_DBG("Ranging data received for ranging counter %d", ranging_counter);

    struct net_buf_simple * latest_local_steps = cs_initiator_get_local_steps();

    if (latest_local_steps->len == 0)
    {
        LOG_WRN("All subevents in ranging counter %u were aborted", local_ranging_counter);

        queue_diagnostic("All subevents aborted: counter %u", local_ranging_counter);

        net_buf_simple_reset(latest_local_steps);
        cs_initiator_give_sem_local_steps();

        if (!(cs_initiator_get_ras_feature_bits() & RAS_FEAT_REALTIME_RD))
        {
            net_buf_simple_reset(cs_initiator_get_peer_steps());
        }
        return;
    }

    /* CS liveness watchdog (#116): the pet trigger is unchanged — a completed
     * procedure with step data, on the RX thread at the completion rate. The
     * blocking TX no longer runs on this thread, though, so a stalled consumer
     * no longer shows up as suppressed pets; it shows up as procedures dropped
     * at the handoff gate below (counted). The len==0 branch above deliberately
     * does NOT pet — during the abort-storm RDs keep arriving at 5/s but never
     * reach this point. */
    cs_watchdog_pet();

    /* The RX thread only populates and publishes the shared event pair; the
     * consumer thread runs the blocking serialize + TX (see
     * process_subevent_cb). The len==0 branch above deliberately does not
     * publish — there is nothing to consume. */
    SubeventResultEvent_t * p_local_event;
    SubeventResultEvent_t * p_peer_event;

    if (cs_initiator_claim_event_pair(&p_local_event, &p_peer_event))
    {
        subevent_populate(p_local_event,
                          p_peer_event,
                          cs_initiator_get_local_mac(),
                          cs_initiator_get_peer_mac(),
                          cs_initiator_get_latest_subevent_header(),
                          latest_local_steps,
                          cs_initiator_get_peer_steps(),
                          cs_config.role);

        cs_initiator_publish_event_pair();
    }
    /* else: the consumer is still busy with the previous item; the claim
     * counted the dropped procedure. */

    net_buf_simple_reset(latest_local_steps);

    if (!(cs_initiator_get_ras_feature_bits() & RAS_FEAT_REALTIME_RD))
    {
        net_buf_simple_reset(cs_initiator_get_peer_steps());
    }

    cs_initiator_give_sem_local_steps();
}

/** @brief Callback for RAS "data ready" — requests on-demand ranging data from peer. */
static void ranging_data_ready_cb(struct bt_conn * p_conn, uint16_t ranging_counter)
{
    LOG_DBG("Ranging data ready %i", ranging_counter);

    if (ranging_counter == cs_initiator_get_local_ranging_counter())
    {
        int err = bt_ras_rreq_cp_get_ranging_data(cs_initiator_get_connection(),
                                                  cs_initiator_get_peer_steps(),
                                                  ranging_counter,
                                                  ranging_data_cb);
        if (err)
        {
            LOG_ERR("Get ranging data failed (err %d)", err);
            net_buf_simple_reset(cs_initiator_get_local_steps());
            net_buf_simple_reset(cs_initiator_get_peer_steps());
            cs_initiator_give_sem_local_steps();
        }
    }
}
#endif /* CONFIG_MARS_CS_INLINE_PCT */

/** @brief Hook that saves the negotiated CS config for later use. */
static void config_create_hook(struct bt_conn_le_cs_config * config)
{
    cs_config = *config;
}

/**
 * @brief Emit the terminal COBS frame for a disconnect (#59).
 *
 * Runs on the BT RX thread from the shared disconnected callback, before the
 * reboot. Closes the ranging stream first, so no later run can follow the
 * terminal frame, then formats the reason exactly as the console line does
 * and hands the frame to the bounded log path: acquire, submit, and drain must
 * all fit CONFIG_MARS_CS_DISCONNECT_FRAME_TIMEOUT_MS, after which the reboot
 * wins. A stalled host therefore costs the frame, never the recovery.
 *
 * The value is the controller's Disconnection Complete reason: the watchdog's
 * HCI command uses 0x13 because the SDC rejects 0x16, but the resulting event
 * still reports 0x16 (see common/cs_watchdog.h).
 */
static void disconnected_hook(uint8_t reason)
{
    serialize_close_stream();

    char message[32];
    int  len = snprintf(message, sizeof(message), BLE_CALLBACKS_DISCONNECT_REASON_FORMAT, reason);

    if ((len < 0) || ((size_t)len >= sizeof(message)))
    {
        return;
    }

    (void)serialize_send_log_message_bounded(message, K_MSEC(CONFIG_MARS_CS_DISCONNECT_FRAME_TIMEOUT_MS));
}

/** @brief Fallback reboot if the watchdog's forced disconnect never completes. */
static void reboot_fallback_handler(struct k_timer * timer)
{
    ARG_UNUSED(timer);

    sys_reboot(SYS_REBOOT_COLD);
}

static K_TIMER_DEFINE(reboot_fallback, reboot_fallback_handler, NULL);

/**
 * @brief CS liveness watchdog recovery (#116).
 *
 * Invoked by the watchdog's system-workqueue work item, never from the timer
 * expiry ISR, so the COBS acquire below may block. Emits a COBS banner (the
 * host's only window into the initiator), then forces a disconnect so the
 * existing disconnected_cb -> sys_reboot path recovers both boards. The 2 s
 * fallback timer covers a disconnect that the controller accepts but never
 * completes; if the HCI command itself never completes, the sync wait's
 * timeout assertion resets the board. A refused command is not a graceful
 * path either, so reboot.
 *
 * The banner acquire is bounded by CONFIG_MARS_CS_USB_TX_TIMEOUT_MS on USB
 * builds; its give comes from the CDC ACM workqueue, which the initiator USB
 * fragment moves to a dedicated thread (CONFIG_USBD_CDC_ACM_WORKQUEUE) so it
 * can run while this work blocks on the gate. VCOM builds give the gate from
 * the UART async callback in the UARTE ISR, which needs no separate thread.
 *
 * The disconnect reason is CS_WATCHDOG_DISCONNECT_REASON, not the
 * semantically correct 0x16: the controller rejects 0x16 with HCI status 0x12
 * (see common/cs_watchdog.h).
 */
static void cs_watchdog_recovery_cb(void)
{
    (void)serialize_send_log_message("CS watchdog: no completed procedure, forcing disconnect");

    struct bt_conn * conn = ble_callbacks_get_connection();

    if (conn != NULL && bt_conn_disconnect(conn, CS_WATCHDOG_DISCONNECT_REASON) == 0)
    {
        k_timer_start(&reboot_fallback, K_MSEC(2000), K_NO_WAIT);
        return;
    }

    sys_reboot(SYS_REBOOT_COLD);
}

/*
 * Optional RF-switch supply rail. Boards whose antenna switch needs a supply
 * GPIO driven high add an app-owned property to the `zephyr,user` devicetree
 * node in their board overlay:
 *
 *     / {
 *         zephyr,user {
 *             rf-switch-supply-gpios = <&gpio2 5 GPIO_ACTIVE_HIGH>;
 *         };
 *     };
 *
 * Boards without the property skip this block. The port and pin are entirely
 * board-owned — no model-specific assignment lives in shared code.
 */
#define ZEPHYR_USER_NODE DT_PATH(zephyr_user)

#if DT_NODE_EXISTS(ZEPHYR_USER_NODE) && DT_NODE_HAS_PROP(ZEPHYR_USER_NODE, rf_switch_supply_gpios)
static const struct gpio_dt_spec rf_switch_supply = GPIO_DT_SPEC_GET(ZEPHYR_USER_NODE, rf_switch_supply_gpios);
#endif

int main(void)
{
    int err;

#if DT_NODE_EXISTS(ZEPHYR_USER_NODE) && DT_NODE_HAS_PROP(ZEPHYR_USER_NODE, rf_switch_supply_gpios)
    if (!gpio_is_ready_dt(&rf_switch_supply))
    {
        LOG_ERR("RF switch supply is not ready");
        return 0;
    }

    err = gpio_pin_configure_dt(&rf_switch_supply, GPIO_OUTPUT_ACTIVE);
    if (err)
    {
        LOG_ERR("Failed to configure RF switch supply high (err %d)", err);
        return 0;
    }
#endif

    LOG_INF("Starting Mars Channel Sounding Initiator");

    err = bt_enable(NULL);
    if (err)
    {
        LOG_ERR("Bluetooth init failed (err %d)", err);
        return 0;
    }

#if IS_ENABLED(CONFIG_MARS_CS_TRANSPORT_USB)
    /* Native USB is initialized after the BLE stack: MPSL and the shared
     * HFCLK24M are already up (DRGN-29129 / DRGN-29277). Initialization does
     * not connect the device; the UDC waits for VBUS, so boot never blocks on
     * a missing host and CDC ACM serial init never runs at boot (NCSDK-38624). */
    err = mars_usb_init();
    if (err)
    {
        LOG_ERR("USB init failed (err %d)", err);
        return 0;
    }
#endif

    /* CS liveness watchdog (#116): inert until the first completed procedure
     * with step data pets it, so the handshake never false-triggers it. */
    cs_watchdog_init(cs_watchdog_recovery_cb);

    /* Terminal COBS frame on disconnect (#59): the initiator owns the COBS
     * stream, so it registers the hook on the shared BLE callbacks. The
     * reflector has no COBS stream and registers nothing. */
    ble_callbacks_set_disconnected_hook(disconnected_hook);

    /* Both modes populate on the RX thread and serialize on this thread: RAS
     * from ranging_data_cb, IPT from the shared procedure-completion skeleton. */
    cs_initiator_set_process_subevent_cb(process_subevent_cb);
#if !IS_ENABLED(CONFIG_MARS_CS_INLINE_PCT)
    /* RAS fault-path diagnostics are the only log frames queued through the handoff. */
    cs_initiator_set_process_log_cb(process_log_cb);
    cs_initiator_set_ranging_data_cb(ranging_data_cb);
    cs_initiator_set_ranging_data_ready_cb(ranging_data_ready_cb);
#endif
    cs_initiator_set_config_created_cb(config_create_hook);

    const struct cs_initiator_config config = {
        /* Procedure cadence applies to ALL builds (RAS + IPT): this is
         * intentional, not an IPT leak — the new cadence speeds up
         * measurements across every antenna configuration (see #41).
         * It supersedes the prior RAS-only defaults (procedure_phy=1M,
         * min/max_procedure_interval=20/50, max_procedure_len=1000); any
         * RAS fixture/calibration/range baseline assuming those must be
         * re-baselined. The interval is CONFIG_MARS_CS_PROCEDURE_INTERVAL
         * (default 10, matching the Nordic ras_initiator sample); the bench
         * sets it to 1 for the transport-headroom run.
         * The subevent length and connection interval are computed
         * dynamically in cs_initiator_start from the negotiated config
         * timings, channel map, and antenna paths; the connect-time
         * interval in ble_scanning.c is intentionally conservative and is
         * tightened after the capabilities exchange.
         */
        .cs_sync_phy            = BT_CONN_LE_CS_SYNC_1M_PHY,
        .procedure_phy          = BT_LE_CS_PROCEDURE_PHY_2M,
        .min_procedure_interval = CONFIG_MARS_CS_PROCEDURE_INTERVAL,
        .max_procedure_interval = CONFIG_MARS_CS_PROCEDURE_INTERVAL,
    };

    err = cs_initiator_start(&config);
    if (err)
    {
        LOG_ERR("CS initiator start failed (err %d)", err);
        return 0;
    }

    while (true)
    {
        /* RAS and IPT: this thread is the serialize consumer — this call runs the process callback on the next item
         * the RX thread handed over (see process_subevent_cb and docs/architecture.md for why this must stay off the
         * BT RX thread; #173). */
        cs_initiator_consume_pending_event();
    }

    return 0;
}
```

## src/cobs_tx.h
```c
/*
 * Copyright (c) 2026 Metirionic
 *
 * SPDX-License-Identifier: MIT
 */

#ifndef COBS_TX_H__
#define COBS_TX_H__

#include <stddef.h>
#include <stdint.h>
#include <zephyr/kernel.h>

/**
 * @brief Largest complete serialization run the seam accepts.
 *
 * Two worst-case serialized events (see CHUNK_SIZE in serialize.c) plus a
 * standalone log frame and margin. The serializer sizes its run buffer with
 * this value and the USB backend sizes its full-run ring with it, so a run
 * can always be enqueued atomically.
 *
 * The size is independent of CONFIG_BT_CTLR_SDC_CS_MAX_ANTENNA_PATHS: the
 * mars-bluetooth-hci wire format's Mode2 tone arrays are fixed at
 * MAX_ANTENNA_PATH_COUNT + 1 entries (four paths plus the extension slot), so
 * the four-path product policy leaves this buffer unchanged. See the
 * antenna-path policy in docs/hardware.md.
 */
#define COBS_TX_RUN_MAX_SIZE 29000u

/**
 * @brief Worst-case drain time a backend may need for a small submitted run.
 *
 * The bounded terminal-frame path reserves this much of its budget for the
 * drain, so the acquisition wait cannot starve it and leave the reboot to cut
 * a submitted frame. The USB backend also uses it as its settle window: the
 * CDC ACM UART API exposes no TX-complete signal, so the class ring and the
 * USB IN transfer that follow the backend's full-run ring get this much time.
 */
#define COBS_TX_IDLE_BOUND_MS 50

/**
 * @brief Reserve the COBS transmit path for the next serialization run.
 *
 * Waits until the transport can accept a run and the run buffer may be filled
 * again: the previously submitted run must have completed transmission before
 * its bytes are overwritten. Must be called before writing into the run
 * buffer; a successful call is either consumed by cobs_tx_write() or given
 * back with cobs_tx_release().
 *
 * A backend may impose its own bound even when timeout is K_FOREVER. The USB
 * backend does, so a stalled host turns into a counted run drop and -EAGAIN
 * instead of blocking the consumer.
 *
 * @param timeout  Wait limit for the previous run to complete.
 * @return 0 on success, -EAGAIN on timeout, or another negative errno when the
 *         transport could not be initialized.
 */
int cobs_tx_acquire(k_timeout_t timeout);

/**
 * @brief Submit one complete serialization run to the transport.
 *
 * The buffer must hold a complete COBS-encoded run. The transport never
 * splits or re-frames it. On success it owns the run until transmission
 * completes; the caller must not touch the buffer until the next successful
 * cobs_tx_acquire().
 *
 * On failure nothing was submitted and the caller keeps the acquisition: the
 * buffer is still writable, and the caller must either retry or call
 * cobs_tx_release().
 *
 * @param p_data   Complete COBS-encoded run.
 * @param size     Run size in bytes.
 * @param timeout  Wait limit for transport-specific transmit space. The
 *                 acquisition already reserved the run buffer; a transport
 *                 whose submission is asynchronous ignores this.
 * @return 0 if the run was accepted, negative errno otherwise.
 */
int cobs_tx_write(const uint8_t * p_data, size_t size, k_timeout_t timeout);

/**
 * @brief Give back an acquired run that was never submitted.
 *
 * Releases the path reserved by cobs_tx_acquire() when no run was submitted
 * (for example after a serialization failure). Must not be called after a
 * successful cobs_tx_write() — that run releases the path on completion.
 */
void cobs_tx_release(void);

/**
 * @brief Wait, bounded, for a submitted run to leave the firmware's buffers.
 *
 * The terminal-frame path (the initiator's disconnect emission) calls this
 * after a successful cobs_tx_write() and before sys_reboot(): the write path
 * is asynchronous, so without the wait the reset can cut the frame. "Left the
 * buffers" is backend-defined: the VCOM backend waits for the UART async
 * TX-done signal; the USB backend waits for its full-run ring to be handed to
 * the CDC ACM driver and then gives that driver's own ring and the USB IN
 * transfer a bounded settle window. With nothing in flight the wait completes
 * without blocking on a transfer; the USB backend still spends its settle
 * window, because the driver ring and the IN transfer are part of what it
 * drains.
 *
 * @param timeout  Wait limit. A backend may apply its own bound even when
 *                 timeout is K_FOREVER (the USB backend does), so a stalled
 *                 host cannot hold the caller past that bound.
 * @return 0 if no submitted run is still in the backend's buffers, -EAGAIN if
 *         one remained when the wait expired.
 */
int cobs_tx_idle(k_timeout_t timeout);

#endif /* COBS_TX_H__ */
```

## src/cobs_tx_usb.c
```c
/*
 * Copyright (c) 2026 Metirionic
 *
 * SPDX-License-Identifier: MIT
 */

/** @file
 *  @brief USB COBS transmit backend (CDC ACM, interrupt-driven UART API)
 *
 * The CDC ACM data UART is fed from a full-run ring owned by this backend.
 * A complete serialization run is copied into the ring in one operation once
 * the previous run has been fully handed to the CDC ACM driver, so runs never
 * interleave and a host stall cannot leave a partially enqueued run.
 *
 * The CDC ACM UART is drained from its IRQ callback, which is also the only
 * context that calls uart_fifo_fill() — the CDC ACM UART API requires the
 * driver's workqueue context. The initiator USB fragment moves that work to
 * the dedicated CDC ACM thread (CONFIG_USBD_CDC_ACM_WORKQUEUE), so the callback
 * can give the path back while the CS liveness watchdog's recovery work waits
 * on it from the system workqueue. The callback gives the path back when the
 * full-run ring empties.
 *
 * Host-stall policy: the acquire wait is bounded (CONFIG_MARS_CS_USB_TX_TIMEOUT_MS)
 * even when the serializer passes K_FOREVER. A run that does not fit in that
 * time is dropped and counted; the run already being drained keeps its place,
 * so the wire never sees a truncated run followed by a new one.
 */

#include <zephyr/drivers/uart.h>
#include <zephyr/kernel.h>
#include <zephyr/logging/log.h>
#include <zephyr/sys/ring_buffer.h>

#include "cobs_tx.h"
#include "mars_usb.h"

LOG_MODULE_DECLARE(app_main, LOG_LEVEL_INF);

#if IS_ENABLED(CONFIG_MARS_CS_TRANSPORT_USB)

#define DT_DRV_COMPAT zephyr_cdc_acm_uart
#include <zephyr/devicetree.h>

/**
 * The role overlay declares the CDC ACM functions in interface order. The
 * initiator's data function must be instance 0 (chosen cobs-uart) and the
 * console instance 1, because the descriptor order is what the host's stable
 * by-id names (if00 data, if02 console) expose.
 *
 * The non-release debug posture (CONFIG_MARS_CS_USB_DEBUG_CONSOLE_VCOM) moves only
 * the log console to the J-Link VCOM: the data function stays instance 0 and
 * must still be the chosen cobs-uart, while the chosen console must not be a
 * CDC ACM function at all. The USB console function remains instance 1 in the
 * descriptor but nothing writes to it.
 */
#if IS_ENABLED(CONFIG_MARS_CS_ROLE_INITIATOR)
BUILD_ASSERT(DT_DEP_ORD(DT_CHOSEN(cobs_uart)) == DT_DEP_ORD(DT_DRV_INST(0)),
             "cobs-uart must be the first CDC ACM function (data first, console second)");
#if IS_ENABLED(CONFIG_MARS_CS_USB_DEBUG_CONSOLE_VCOM)
BUILD_ASSERT(!DT_NODE_HAS_COMPAT(DT_CHOSEN(zephyr_console), zephyr_cdc_acm_uart),
             "The USB debug console must be a non-CDC-ACM UART (the J-Link VCOM on the DK)");
#else
BUILD_ASSERT(DT_DEP_ORD(DT_CHOSEN(zephyr_console)) == DT_DEP_ORD(DT_DRV_INST(1)),
             "zephyr,console must be the second CDC ACM function (data first, console second)");
#endif
#endif

/** @brief CDC ACM data UART (the cobs-uart chosen node). */
static const struct device * gp_cobs_usb_dev = DEVICE_DT_GET(DT_CHOSEN(cobs_uart));

/** @brief One worst-case serialization run; the whole run is enqueued at once. */
RING_BUF_DECLARE(cobs_usb_tx_ring, COBS_TX_RUN_MAX_SIZE);

/** @brief Serializes producer (acquire/write/release) and IRQ-callback ring access. */
static struct k_spinlock g_tx_lock;

/** @brief Run-path gate: count 1 when no run is queued or draining. */
static K_SEM_DEFINE(sem_tx_free, 1, 1);

/** @brief Runs dropped because the host was absent/stalled or not enumerated. */
static atomic_t g_drop_count;

static bool g_initialized;

/**
 * @brief Count one dropped run and log the first and every 128th drop.
 *
 * Mirrors the RX-thread handoff gate's drop reporting so a host stall is
 * visible on the console without flooding it.
 */
static void cobs_usb_note_drop(const char * p_reason)
{
    uint32_t drops = (uint32_t)atomic_inc(&g_drop_count) + 1u;

    if ((drops == 1u) || ((drops % 128u) == 0u))
    {
        LOG_WRN("COBS USB: dropped run (%s), %u dropped", p_reason, drops);
    }
}

/**
 * @brief CDC ACM UART IRQ callback: drain the full-run ring into the driver.
 *
 * Runs on the CDC ACM workqueue — the driver's dedicated thread with
 * CONFIG_USBD_CDC_ACM_WORKQUEUE, the only context allowed to call
 * uart_fifo_fill(). It copies as much as the CDC ACM TX ring accepts and
 * stops when either the run ring is empty or the TX ring is full. The driver
 * resubmits this callback on the next TX completion, so no polling is needed.
 */
static void cobs_usb_irq_cb(const struct device * p_dev, void * p_user_data)
{
    ARG_UNUSED(p_user_data);

    k_spinlock_key_t key = k_spin_lock(&g_tx_lock);

    while (!ring_buf_is_empty(&cobs_usb_tx_ring))
    {
        uint8_t * p_data;
        uint32_t  len = ring_buf_get_claim(&cobs_usb_tx_ring, &p_data, ring_buf_size_get(&cobs_usb_tx_ring));

        if (len == 0u)
        {
            break;
        }

        int written = uart_fifo_fill(p_dev, p_data, (int)len);

        if (written < 0)
        {
            written = 0;
        }

        (void)ring_buf_get_finish(&cobs_usb_tx_ring, (uint32_t)written);

        if ((uint32_t)written < len)
        {
            /* CDC ACM TX ring is full; the next completion calls us again. */
            break;
        }
    }

    if (ring_buf_is_empty(&cobs_usb_tx_ring))
    {
        /* Disable unconditionally: a queued callback may have drained the
         * run before the producer enabled the IRQ, so the driver's
         * "IRQ enabled with space" condition must not be left set — it would
         * resubmit this callback forever on an empty ring. */
        uart_irq_tx_disable(p_dev);

        /* The run has been handed to the driver; the path is free. */
        k_sem_give(&sem_tx_free);
    }

    k_spin_unlock(&g_tx_lock, key);
}

/**
 * @brief One-time backend initialization (callback registration).
 *
 * @return 0 on success, negative errno on error.
 */
static int cobs_usb_init(void)
{
    if (g_initialized)
    {
        return 0;
    }

    if (!device_is_ready(gp_cobs_usb_dev))
    {
        LOG_ERR("COBS USB data UART not ready");
        return -ENODEV;
    }

    ring_buf_reset(&cobs_usb_tx_ring);
    uart_irq_callback_set(gp_cobs_usb_dev, cobs_usb_irq_cb);
    g_initialized = true;

    return 0;
}

/**
 * @brief Apply the bounded stall timeout to an acquire wait.
 *
 * The serializer asks for K_FOREVER because the VCOM backend only waits for
 * the previous DMA transfer. The USB backend must bound the wait so a host
 * stall cannot park the consumer thread forever.
 */
static k_timeout_t cobs_usb_acquire_timeout(k_timeout_t timeout)
{
    if (K_TIMEOUT_EQ(timeout, K_FOREVER))
    {
        return K_MSEC(CONFIG_MARS_CS_USB_TX_TIMEOUT_MS);
    }

    return timeout;
}

int cobs_tx_acquire(k_timeout_t timeout)
{
    int err = cobs_usb_init();

    if (err)
    {
        return err;
    }

    err = k_sem_take(&sem_tx_free, cobs_usb_acquire_timeout(timeout));
    if (err)
    {
        cobs_usb_note_drop("transport busy");
        return err;
    }

    return 0;
}

int cobs_tx_write(const uint8_t * p_data, size_t size, k_timeout_t timeout)
{
    /* The acquisition reserved the run path; enqueueing is a bounded copy
     * into the run ring, so the transport-specific wait is not used here. */
    ARG_UNUSED(timeout);

    if ((size == 0u) || (size > COBS_TX_RUN_MAX_SIZE))
    {
        LOG_ERR("COBS USB run has invalid size %u", (unsigned)size);
        return -EMSGSIZE;
    }

    if (!mars_usb_is_configured())
    {
        /* Nothing is buffered before the host enumerates: the output would be
         * stale by the time a capture opens. Count it like any other drop and
         * give the path back; the caller treats the run as handled. */
        cobs_usb_note_drop("not enumerated");
        k_sem_give(&sem_tx_free);
        return 0;
    }

    k_spinlock_key_t key     = k_spin_lock(&g_tx_lock);
    uint32_t         written = ring_buf_put(&cobs_usb_tx_ring, p_data, (uint32_t)size);

    if (written != size)
    {
        /* The ring is empty on entry, so this is a sizing bug, not backpressure. */
        ring_buf_reset(&cobs_usb_tx_ring);
        k_spin_unlock(&g_tx_lock, key);
        LOG_ERR("COBS USB run ring overflow (%u of %u bytes)", written, (unsigned)size);
        return -ENOSPC;
    }

    k_spin_unlock(&g_tx_lock, key);

    /* Enable after the run is in the ring: a callback that runs before this
     * point can already have drained the run, so the disable in the callback
     * must be unconditional. */
    uart_irq_tx_enable(gp_cobs_usb_dev);

    return 0;
}

void cobs_tx_release(void)
{
    k_spinlock_key_t key = k_spin_lock(&g_tx_lock);

    if (!ring_buf_is_empty(&cobs_usb_tx_ring))
    {
        /* Defensive: release must only follow a failed submission. */
        ring_buf_reset(&cobs_usb_tx_ring);
    }

    uart_irq_tx_disable(gp_cobs_usb_dev);
    k_sem_give(&sem_tx_free);
    k_spin_unlock(&g_tx_lock, key);
}

int cobs_tx_idle(k_timeout_t timeout)
{
    if (!g_initialized)
    {
        return 0;
    }

    if (!mars_usb_is_configured())
    {
        /* An unenumerated device's run is dropped in cobs_tx_write(), which
         * already gave the gate back, so nothing was buffered. */
        return 0;
    }

    int64_t start = k_uptime_get();
    int     err   = k_sem_take(&sem_tx_free, cobs_usb_acquire_timeout(timeout));

    if (err)
    {
        return -EAGAIN;
    }

    /* The full-run ring is empty: every byte is in the CDC ACM class ring or
     * already on the bus. Give the driver's ring and the IN transfer their
     * settle window (COBS_TX_IDLE_BOUND_MS), bounded by what is left of the
     * caller's budget. */
    int64_t settle_ms = COBS_TX_IDLE_BOUND_MS;

    if (!K_TIMEOUT_EQ(timeout, K_FOREVER))
    {
        int64_t left_ms = (int64_t)k_ticks_to_ms_ceil64(timeout.ticks) - (k_uptime_get() - start);

        if (left_ms < settle_ms)
        {
            settle_ms = left_ms;
        }
    }

    if (settle_ms > 0)
    {
        k_msleep((int32_t)settle_ms);
    }

    k_sem_give(&sem_tx_free);
    return 0;
}

#endif /* CONFIG_MARS_CS_TRANSPORT_USB */
```

## src/cobs_tx_vcom.c
```c
/*
 * Copyright (c) 2026 Metirionic
 *
 * SPDX-License-Identifier: MIT
 */

/** @file
 *  @brief VCOM COBS transmit backend (asynchronous UART)
 */

#include <zephyr/drivers/uart.h>
#include <zephyr/logging/log.h>

#include "cobs_tx.h"

LOG_MODULE_DECLARE(app_main, LOG_LEVEL_INF);

/** @brief UART device used for COBS output. */
static const struct device * gp_cobs_uart_dev = DEVICE_DT_GET(DT_CHOSEN(cobs_uart));

/** @brief UART TX-done gate: count 1 when no async TX is in progress.
 *
 * Taken by cobs_tx_acquire() before the caller reuses the run buffer; given by
 * the UART async callback on UART_TX_DONE / UART_TX_ABORTED, or by the caller's
 * cobs_tx_release() when no run was submitted (serialization failure or a
 * failed uart_tx()). Mirrors the sem_local_steps "buffer available" pattern in
 * common/cs_initiator.c, keeping uart_tx from ever being called while a
 * previous transfer is still DMA-ing out of the run buffer.
 */
static K_SEM_DEFINE(sem_tx_done, 1, 1);

/** @brief One-time UART async init guard (callback registered on first use). */
static bool g_uart_async_init_done;

/**
 * @brief UART async callback: signals TX completion to release sem_tx_done.
 *
 * TX-only path: only UART_TX_DONE and UART_TX_ABORTED are handled (RX events
 * are unused). k_sem_give() is ISR-safe, so the give from the UARTE ISR cannot
 * deadlock against the k_sem_take() performed in cobs_tx_acquire() by any
 * caller (BT RX thread, main loop thread, or system workqueue). UART_TX_ABORTED
 * is not expected in practice (no hardware flow control on the COBS UART
 * overlays and uart_tx() uses SYS_FOREVER_MS), but is handled defensively so
 * the gate never sticks.
 */
static void cobs_uart_async_cb(const struct device * p_dev, struct uart_event * p_evt, void * p_user_data)
{
    ARG_UNUSED(p_dev);
    ARG_UNUSED(p_user_data);

    switch (p_evt->type)
    {
    case UART_TX_DONE:
        k_sem_give(&sem_tx_done);
        break;
    case UART_TX_ABORTED:
        LOG_WRN("COBS UART TX aborted (%u bytes sent)", (unsigned)p_evt->data.tx.len);
        k_sem_give(&sem_tx_done);
        break;
    default:
        /* RX events unused (TX-only path). */
        break;
    }
}

/**
 * @brief Register the async UART callback once, on first use.
 *
 * @return 0 on success, negative errno on error.
 */
static int cobs_tx_vcom_init(void)
{
    if (g_uart_async_init_done)
    {
        return 0;
    }

    if (!device_is_ready(gp_cobs_uart_dev))
    {
        LOG_ERR("COBS UART device not ready");
        return -ENODEV;
    }

    int cb_err = uart_callback_set(gp_cobs_uart_dev, cobs_uart_async_cb, NULL);
    if (cb_err)
    {
        LOG_ERR("uart_callback_set failed (err %d)", cb_err);
        return cb_err;
    }

    g_uart_async_init_done = true;
    return 0;
}

int cobs_tx_acquire(k_timeout_t timeout)
{
    int err = cobs_tx_vcom_init();
    if (err)
    {
        return err;
    }

    return k_sem_take(&sem_tx_done, timeout);
}

int cobs_tx_write(const uint8_t * p_data, size_t size, k_timeout_t timeout)
{
    /* The acquisition already waited for the previous transfer, so the
     * submission cannot block; keep the pre-seam driver timeout unchanged. */
    ARG_UNUSED(timeout);

    return uart_tx(gp_cobs_uart_dev, p_data, size, SYS_FOREVER_MS);
}

void cobs_tx_release(void)
{
    k_sem_give(&sem_tx_done);
}

int cobs_tx_idle(k_timeout_t timeout)
{
    if (!g_uart_async_init_done)
    {
        /* No run was ever submitted, so none can still be in flight. */
        return 0;
    }

    /* Taking the gate is how this backend observes completion: the UART async
     * callback gives it on UART_TX_DONE, which the nRF UARTE driver raises
     * after the last byte left the DMA buffer. Give it straight back so the
     * seam state is unchanged for any later acquisition (the disconnect path
     * has none, but the contract stays true). */
    int err = k_sem_take(&sem_tx_done, timeout);

    if (err)
    {
        return -EAGAIN;
    }

    k_sem_give(&sem_tx_done);
    return 0;
}
```

## src/serialize.h
```c
/*
 * Copyright (c) 2024 Nordic Semiconductor ASA
 *
 * SPDX-License-Identifier: MIT
 */

#ifndef SERIALIZE_H__
#define SERIALIZE_H__

#include <zephyr/kernel.h>

#include "mars_bluetooth_hci.h"

/**
 * @brief Serialize populated SubeventResultEvents and transmit them.
 *
 * Hands each complete serialization run to the COBS transmit seam; the
 * build-selected backend owns the actual transport.
 *
 * @param p_local_event  Populated initiator SubeventResultEvent.
 * @param p_peer_event   Populated reflector SubeventResultEvent.
 */
void serialize_run(SubeventResultEvent_t * p_local_event, SubeventResultEvent_t * p_peer_event);

/**
 * @brief Serialize a log message and transmit it as a standalone run.
 *
 * Fault-path diagnostic entry point for events outside serialize_run
 * (e.g. the ranging data error path): the stall trigger that stops the
 * event stream is emitted here so a host capturing only the COBS stream can
 * see it. Honors the same transmit-path gate as serialize_run.
 *
 * @param p_message  NUL-terminated message.
 * @return 0 on success, negative errno on error.
 */
int serialize_send_log_message(const char * p_message);

/**
 * @brief Close the ranging stream: refuse every later run.
 *
 * The terminal disconnect frame (serialize_send_log_message_bounded) is the
 * one writer allowed after this call. serialize_run() and
 * serialize_send_log_message() return immediately once the stream is closed,
 * and serialize_run() re-checks after it acquires the path, so a consumer
 * that was waiting on the seam cannot submit a ranging run behind the
 * terminal frame. Any run already holding the path finishes first — the
 * bounded send waits for it.
 *
 * Called once, from the initiator's disconnect path, before the reboot.
 */
void serialize_close_stream(void);

/**
 * @brief Send a standalone log frame and wait, bounded, for it to drain.
 *
 * Terminal-frame variant of serialize_send_log_message(): acquires the seam,
 * serializes the message as one complete run, submits it, and waits for it to
 * leave the transport's buffers. The whole sequence — acquire, serialize,
 * submit, drain — is bounded by @p timeout; a ranging run in flight, a stalled
 * host, or a wedged transport consumes the budget and this returns without
 * the frame being complete. The caller (the disconnect path) reboots either
 * way, so the frame is best effort and the reboot wins. K_FOREVER removes the
 * bound; the disconnect path always passes a finite one.
 *
 * Not gated by serialize_close_stream(): this is the frame that closes the
 * stream. Call serialize_close_stream() first so no run can follow it.
 *
 * @param p_message  NUL-terminated message.
 * @param timeout    Bound on the whole emission.
 * @return 0 if the frame was submitted and drained within the bound, negative
 *         errno otherwise (-EAGAIN when a wait expired).
 */
int serialize_send_log_message_bounded(const char * p_message, k_timeout_t timeout);

#endif /* SERIALIZE_H__ */
```
